## config/boards/shields/anise85n/Kconfig.defconfig
```kconfig
# Copyright (c) 2020 The ZMK Contributors
# SPDX-License-Identifier: MIT
 
 
if SHIELD_ANISE85N_LEFT

config ZMK_KEYBOARD_NAME
	default "ANISE85N"

config ZMK_SPLIT_ROLE_CENTRAL
	default y

endif

if SHIELD_ANISE85N_LEFT || SHIELD_ANISE85N_RIGHT

config ZMK_SPLIT
	default y

endif
```

## config/boards/shields/anise85n/Kconfig.shield
```kconfig
# Copyright (c) 2020 The ZMK Contributors
# SPDX-License-Identifier: MIT

config SHIELD_ANISE85N_LEFT
	def_bool $(shields_list_contains,anise85n_left)

config SHIELD_ANISE85N_RIGHT
	def_bool $(shields_list_contains,anise85n_right)
```

## config/west.yml
```yaml
manifest:
  remotes:
    - name: anisehid
      url-base: https://github.com/anisehid
  projects:
    - name: zmk
      remote: anisehid
      revision: main
      import: app/west.yml
  self:
    path: config
```
